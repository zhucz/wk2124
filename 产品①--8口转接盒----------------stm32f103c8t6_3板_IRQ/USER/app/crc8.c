
#include <string.h>
#include "crc8.h"
#include "stm32f10x.h"  //used for uint8_t symbol


/*-----------------------二、CRC8计算函数---------------------------------------
 * API 名称：crc8
 * 注    解：CRC8计算API
 * 修改时间：2014-07-18 
 * 说    明: 输入参数希望校验的数组
 *------------------------------------------------------------------------------
 */
uint8_t crc8(uint8_t* ptr,uint16_t len)
{
    uint8_t i = 0;
    uint8_t crc = 0;
   
    while(len--)
    {
        i = 0x80;
        while(i != 0)
        {
            if(((crc & 0x80) != 0) && (((*ptr) & i) != 0))//CRC最高位为1且校验bit为1
            {
                    crc <<= 1;
            }
            else if(((crc & 0x80)!= 0) && (((*ptr) & i)==0))//CRC最高位为1且校验bit为0
            {
                    crc <<= 1;
                    crc ^= 0x31;
            }
            else if(((crc & 0x80) == 0)&& (((*ptr) & i) !=0))//CRC最高位为0且校验bit为1
            {
                    crc <<= 1;
                    crc ^= 0x31;
            }
            else if(((crc & 0x80) == 0) &&(((*ptr)&i)== 0))//CRC最高位为0且校验bit为0
            {
                    crc <<= 1;
            }
            i >>= 1;
        }
        ptr++;
    }

    return(crc);
}


/*-----------------------三、app_calccrc8----------------------------------------------
 * API 名称：crc
 * 注    解：返回0，表示crc不匹配，返回1，表示crc匹配
 * 修改时间：2014-07-15 
 * 说    明: 无
 *------------------------------------------------------------------------------
 */
uint8_t  app_calccrc8(uint8_t *dat, uint16_t datlen)
{
   uint16_t framelen = dat[1]<<8|dat[2];
   uint8_t  calccrc8 = 0;
   
   if((framelen > datlen) || *(dat + 0) == 0x00){
      //如果计算出来的帧数据的长度，超过了实际接收到的长度，那么不用计算，crc8肯定是错的
      return 0;
   }else{
      calccrc8 = crc8(dat, framelen);
      if((calccrc8 == dat[framelen])&& (*(dat + 0) == 0x7E) && (*(dat + framelen + 1) == 0x5A)){
         return 1; //验证通过
      }else{
         return 0; //验证不通过
      }
   }
}

/*-----------------------三、帧数据校验体----------------------------------------------
 * API 名称：delay()
 * 注    解：数据处理中可能用到的短暂延时
 * 修改时间：2014-07-15 
 * 说    明: 无
 *------------------------------------------------------------------------------
 */
void delay(uint32_t times_cnt)
{
    while(times_cnt--);
}

//-----------------------------------------------------------eof----------------------------------------------------------------------
